/*
 * Copyright (C) 2016, Syntacore Ltd.
 * All Rights Reserved.
 */

/dts-v1/;

#include "scr_sdk_htg960.dtsi"
#include "scr_sdk_scr7.dtsi"
#include "scr_sdk_riscv_plic.dtsi"
#include "scr_sdk_cache_info.dtsi"

/ {
    model = "Syntacore SCR7 SDK board";
    compatible = "syntacore,scr7_sdk";

    firmware {
        syntacore,scbl = dtb_fw_scbl_rev:"YYYY-MM-DD version string xxxxxxxxxxxxxxxx xxxxxxxxxxxxxxxx";
        syntacore,bldid = dtb_fw_bldid:"0000000000000000";
        syntacore,impid = dtb_fw_impid:"0000000000000000";
        syntacore,platform = dtb_fw_platform:"xxxxxxxxxxxxxxxx";
    };

    chosen {
#if PLF_MMODE_ONLY == 0
        bootargs = "earlycon=sbi console=ttyS0,115200";
#else
        bootargs = "earlycon=ns16550a,mmio32,0xffffffff010000 console=ttyS0,115200";
#endif
    };
};
